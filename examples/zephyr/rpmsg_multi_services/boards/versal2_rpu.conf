## examples/zephyr/rpmsg_multi_services/boards/versal2_rpu.conf
```kconfig
# SPDX-License-Identifier: Apache-2.0

CONFIG_MBOX=y
CONFIG_MBOX_XLNX_IPI_MAILBOX=y
CONFIG_OPENAMP_WITH_DCACHE=y
CONFIG_XIP=y

CONFIG_SERIAL=n
CONFIG_RAM_CONSOLE=y
CONFIG_RAM_CONSOLE_BUFFER_SIZE=4096
CONFIG_PRINTK=y
CONFIG_LOG=y

CONFIG_MAIN_STACK_SIZE=4096
CONFIG_HEAP_MEM_POOL_SIZE=4096
```

## examples/zephyr/rpmsg_multi_services/boards/versal_rpu.conf
```kconfig
# SPDX-License-Identifier: Apache-2.0

CONFIG_MBOX=y
CONFIG_MBOX_XLNX_IPI_MAILBOX=y

CONFIG_SERIAL=n
CONFIG_PRINTK=y
CONFIG_LOG=y

CONFIG_MAIN_STACK_SIZE=4096
CONFIG_HEAP_MEM_POOL_SIZE=4096
```

## examples/zephyr/rpmsg_multi_services/boards/zynqmp_rpu.conf
```kconfig
# SPDX-License-Identifier: Apache-2.0

CONFIG_SERIAL=n
CONFIG_RAM_CONSOLE=y
CONFIG_RAM_CONSOLE_BUFFER_SIZE=4096
```
